## conf/distro/duo-os.conf
```bitbake
DISTRO = "duo-os"
DISTRO_NAME = "Duo-OS (Milk-V Duo Boards Distro)"
DISTRO_VERSION = "0.0.0"

MAINTAINER = "Hiago De Franco <hfranco@baylibre.com>"

PACKAGE_CLASSES ?= "package_ipk"

DISTRO_FEATURES ?= "acl ipv4 ipv6 keyboard vfat"
DISTRO_FEATURES_OPTED_OUT = "*"

DISTROOVERRIDES = "duo-os"

BB_SIGNATURE_HANDLER ?= "OEEquivHash"
BB_HASHSERVE ??= "auto"

INIT_MANAGER:duo-os ?= "systemd"
INIT_MANAGER:duo-os:libc-musl ?= "sysvinit"

TCLIBC:duo-os:milkv-duo ?= "musl"
```
